## components/network/Kconfig
```kconfig
menu "Network Configuration"

config WIFI_SSID
    string "WiFi SSID"
    default ""
    help
        WiFi network name

config WIFI_PASSWORD
    string "WiFi Password"
    default ""
    help
        WiFi network password

endmenu
```

## components/telemetry/Kconfig
```kconfig
menu "Azure IoT Configuration"

config AZURE_IOT_HOSTNAME
    string "Azure IoT Hub Hostname"
    default ""
    help
        Example: myhub.azure-devices.net

config AZURE_IOT_DEVICE_ID
    string "Azure IoT Device ID"
    default ""
    help
        Device ID registered in IoT Hub

config AZURE_IOT_SAS_TOKEN
    string "Azure IoT SAS Token"
    default ""
    help
        SAS token (use only for testing, not production)

endmenu
```

## sdkconfig.defaults
```kconfig
# =========================================================
# ESP-IDF Project Defaults (ESP-IDF v5.2.6)
# Azure IoT Hub + MQTT + TLS + SNTP
# =========================================================

# ---------------------------------------------------------
# Logging
# ---------------------------------------------------------
CONFIG_LOG_DEFAULT_LEVEL_INFO=y
CONFIG_LOG_MAXIMUM_LEVEL_VERBOSE=y

# ---------------------------------------------------------
# Flash configuration (ESP32 – 4MB)
# ---------------------------------------------------------
CONFIG_ESPTOOLPY_FLASHMODE_DIO=y
CONFIG_ESPTOOLPY_FLASHFREQ_80M=y
CONFIG_ESPTOOLPY_FLASHSIZE_4MB=y

# ---------------------------------------------------------
# Wi-Fi credentials (used by your wifi.c)
# ---------------------------------------------------------


# ---------------------------------------------------------
# SNTP / Time Sync (CRITICAL for SAS token validation)
# ---------------------------------------------------------
CONFIG_LWIP_SNTP_ENABLE=y
CONFIG_LWIP_DHCP_MAX_NTP_SERVERS=1
CONFIG_LWIP_SNTP_SERVER_ADDRESS="pool.ntp.org"

# ---------------------------------------------------------
# MQTT Configuration (Azure IoT Hub REQUIREMENTS)
# ---------------------------------------------------------
CONFIG_MQTT_PROTOCOL_311=y
CONFIG_MQTT_TRANSPORT_SSL=y

# ---------------------------------------------------------
# TLS / mbedTLS (Azure IoT Hub compliant)
# ---------------------------------------------------------
CONFIG_MBEDTLS_CERTIFICATE_BUNDLE=y
CONFIG_MBEDTLS_SSL_MAX_CONTENT_LEN=16384

# ---------------------------------------------------------
# FreeRTOS / Stack Sizes
# (TLS + MQTT + JSON are stack-heavy)
# ---------------------------------------------------------
CONFIG_ESP_MAIN_TASK_STACK_SIZE=8192
CONFIG_MQTT_TASK_STACK_SIZE=6144
CONFIG_FREERTOS_TIMER_TASK_STACK_DEPTH=4096

# ---------------------------------------------------------
# End of file
# ---------------------------------------------------------
# This file was generated using idf.py save-defconfig.
# It can be edited manually.
# Espressif IoT Development Framework (ESP-IDF) 5.2.6


CONFIG_AZURE_IOT_HOSTNAME=""
CONFIG_AZURE_IOT_DEVICE_ID=""
CONFIG_AZURE_IOT_SAS_TOKEN=""
CONFIG_WIFI_SSID=""
CONFIG_WIFI_PASSWORD=""
CONFIG_AZURE_IOT_CONNECTION_STRING=
```
